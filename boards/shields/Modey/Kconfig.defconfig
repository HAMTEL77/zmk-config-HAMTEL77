## boards/shields/Modey/Kconfig.defconfig
```kconfig
if SHIELD_MOD_R

config ZMK_KEYBOARD_NAME
    default "Modey_R"

config ZMK_SPLIT
    default y

config ZMK_SPLIT_ROLE_CENTRAL
    default y

endif

if SHIELD_MOD_L

config ZMK_KEYBOARD_NAME
    default "Modey_L"

config ZMK_SPLIT
    default y

endif

if ZMK_KEYBOARD_YOUR_KEYBOARD

config ZMK_POINTING
    default y

config IQS7211E
    default y

endif
```

## config/west.yml
```yaml
manifest:
  defaults:
    revision: v0.3
  remotes:
    - name: zmkfirmware
      url-base: https://github.com/zmkfirmware
    - name: HAMTEL77
      url-base: https://github.com/HAMTEL77
    - name: sekigon-gonnoc
      url-base: https://github.com/sekigon-gonnoc
  projects:
    - name: zmk
      remote: zmkfirmware
      import: app/west.yml
    - name: zmk-driver-iqs7211e
      remote: sekigon-gonnoc
      revision: master
  self:
    path: config
```
